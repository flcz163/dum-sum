/*
 * Device Tree Source for ZX296716 SoC thermal
 *
 * Copyright (c) 2016, Jun Nie <jun.nie@linaro.org>
 *
 * This file is licensed under the terms of the GNU General Public License
 * version 2.  This program is licensed "as is" without any warranty of any
 * kind, whether express or implied.
 */

#include <dt-bindings/thermal/thermal.h>

gpu_thermal: gpu_thermal {
	polling-delay-passive = <1000>; /* milliseconds */
	polling-delay = <5000>; /* milliseconds */

	thermal-sensors = <&tempsensor 0>;
	
};