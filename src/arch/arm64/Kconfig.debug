## src/arch/arm64/Kconfig.debug
```kconfig
menu "Kernel hacking"

source "lib/Kconfig.debug"

config FRAME_POINTER
        bool
        default y

endmenu
```

## src/drivers/irqchip/Kconfig
```kconfig
config IRQCHIP
        def_bool y

config ARM_GIC
        bool
        select IRQ_DOMAIN
        select IRQ_DOMAIN_HIERARCHY
        select MULTI_IRQ_HANDLER

config ARM_GIC_V3
        bool
        select IRQ_DOMAIN
        select MULTI_IRQ_HANDLER
        select IRQ_DOMAIN_HIERARCHY
```

## src/lib/Kconfig.debug
```kconfig
config DEBUG_KERNEL
	bool "Kernel debugging"
	default y
	help
	  Say Y here if you are developing drivers or trying to debug and
	  identify kernel problems.

config FRAME_POINTER
        bool "Compile the kernel with frame pointers"
        depends on DEBUG_KERNEL || ARCH_WANT_FRAME_POINTERS
        default y if ARCH_WANT_FRAME_POINTERS
        help
          If you say Y here the resulting kernel image will be slightly
          larger and slower, but it gives very useful debugging information
          in case of kernel bugs. (precise oopses/stacktraces/warnings)
```
